#ifndef FONT5X7_H
#define FONT5X7_H

#include <Arduino.h>

// 5x7 Pixel Font (ASCII 32-126)
// Each character is 5 columns, each column is 7 bits (bit 0 = top)

const uint8_t font5x7[][5] PROGMEM = {
    {0x00, 0x00, 0x00, 0x00, 0x00}, // 32 Space
    {0x00, 0x00, 0x5F, 0x00, 0x00}, // 33 !
    {0x00, 0x07, 0x00, 0x07, 0x00}, // 34 "
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    {0x08, 0x08, 0x2A, 0x1C, 0x08}, // 126 ~
};

// German Umlaute (separate array for special characters)
// Index: 0=Ae, 1=Oe, 2=Ue, 3=ae, 4=oe, 5=ue, 6=ss
const uint8_t fontUmlaute[][5] PROGMEM = {
    {0x7C, 0x13, 0x12, 0x13, 0x7C}, // 0: Ae (A mit Punkten oben)
    {0x3C, 0x43, 0x42, 0x43, 0x3C}, // 1: Oe (O mit Punkten oben)
    {0x3D, 0x42, 0x40, 0x42, 0x3D}, // 2: Ue (U mit Punkten oben)
    {0x20, 0x55, 0x54, 0x55, 0x78}, // 3: ae (a mit Punkten oben)
    {0x38, 0x45, 0x44, 0x45, 0x38}, // 4: oe (o mit Punkten oben)
    {0x3C, 0x41, 0x40, 0x21, 0x7C}, // 5: ue (u mit Punkten oben)
    {0x7F, 0x49, 0x49, 0x49, 0x36}, // 6: ss (Eszett, like B)
};

// Get glyph data for a character, handling UTF-8 Umlaute
// Returns pointer to 5-byte glyph data, advances *str past the character
// Returns nullptr for unsupported characters
inline const uint8_t* getGlyph(const char** str) {
    uint8_t c = (uint8_t)**str;

    // Check for UTF-8 multi-byte sequence (German Umlaute start with 0xC3)
    if (c == 0xC3 && (*str)[1] != 0) {
        uint8_t c2 = (uint8_t)(*str)[1];
        (*str) += 2;  // Advance past 2-byte sequence

        switch (c2) {
            case 0x84: return fontUmlaute[0];  // Ae
            case 0x96: return fontUmlaute[1];  // Oe
            case 0x9C: return fontUmlaute[2];  // Ue
            case 0xA4: return fontUmlaute[3];  // ae
            case 0xB6: return fontUmlaute[4];  // oe
            case 0xBC: return fontUmlaute[5];  // ue
            case 0x9F: return fontUmlaute[6];  // ss
            default:   return font5x7['?' - 32];  // Unknown
        }
    }

    // Regular ASCII
    (*str)++;
    if (c >= 32 && c <= 126) {
        return font5x7[c - 32];
    }

    // Unsupported character
    return font5x7['?' - 32];
}

// Count display characters in UTF-8 string (Umlaute count as 1)
inline int countDisplayChars(const char* str) {
    int count = 0;
    while (*str) {
        uint8_t c = (uint8_t)*str;
        if (c == 0xC3 && str[1] != 0) {
            str += 2;  // UTF-8 2-byte sequence
        } else {
            str++;
        }
        count++;
    }
    return count;
}

#endif
